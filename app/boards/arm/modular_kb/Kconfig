## app/boards/arm/modular_kb/Kconfig
```kconfig
config BOARD_ENABLE_DCDC
	bool "Enable DCDC mode"
	select SOC_DCDC_NRF52X
	default y
	depends on (BOARD_MODULAR_KB)

config BOARD_MODULAR_KB_CHARGER
	bool "Enable battery charger"
	default y
	depends on (BOARD_MODULAR_KB)
```

## app/boards/arm/modular_kb/Kconfig.board
```kconfig
#  board configuration

# Copyright (c) 2020 The ZMK Contributors
# SPDX-License-Identifier: MIT

config BOARD_MODULAR_KB
	bool "modular_kb"
	depends on SOC_NRF52840_QIAA
```

## app/boards/arm/modular_kb/Kconfig.defconfig
```kconfig
# Copyright (c) 2020 The ZMK Contributors
# SPDX-License-Identifier: MIT

if BOARD_MODULAR_KB

config BOARD
	default "modular_kb"

config USB_NRFX
	default y

config USB_DEVICE_STACK
	default y

config BT_CTLR
 	default BT

config ZMK_BLE
	default y

config ZMK_KEYBOARD_NAME
	default "HF Modular KB"

config ZMK_KSCAN_MATRIX_POLLING
    default y

config ZMK_USB  
	default y

endif # BOARD_MODULAR_KB
```

## app/boards/shields/hal9000/Kconfig.shield
```kconfig
config SHIELD_HAL9000_DONGLE
    def_bool $(shields_list_contains,hal9000_dongle)
```

## app/boards/shields/modular_kb/Kconfig.defconfig
```kconfig
if SHIELD_MODULAR_KB_RIGHT

config ZMK_KEYBOARD_NAME
    default "My Board right"

config ZMK_SPLIT_ROLE_CENTRAL
    default y

endif

if SHIELD_MODULAR_KB_LEFT || SHIELD_MODULAR_KB_RIGHT

config ZMK_SPLIT
    default y

endif
```

## app/boards/shields/modular_kb/Kconfig.shield
```kconfig
config SHIELD_MODULAR_KB_LEFT
    def_bool $(shields_list_contains,modular_kb_left)

config SHIELD_MODULAR_KB_RIGHT
    def_bool $(shields_list_contains,modular_kb_right)
```
